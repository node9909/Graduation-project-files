/*
 * TinyOzOled.c
 *
 * Created: 5-7-2019 11:19:25
 *  Author: okersten
 */ 

#include "TinyOzOled.h"
#include "TinyWireM.h"
#include <util/delay.h>
#include <avr/io.h>
#include <avr/pgmspace.h>

const uint16_t BasicFont[][8] PROGMEM = {
	{0x00,0x00,0x00,0x00,0x00,0x00,0x00,0x00},
	{0x00,0x00,0x5F,0x00,0x00,0x00,0x00,0x00},
	{0x00,0x00,0x07,0x00,0x07,0x00,0x00,0x00},
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	{0x00,0x02,0x05,0x05,0x02,0x00,0x00,0x00}
};



void sendCommand(uint8_t command){
	beginTransmission(0x3C);	// Start + slave address
	write(0x80);				// Register Adress
	write(command);				// Byte
	endTransmission1();			// stop transmitting
}

void sendData(uint8_t data){
	beginTransmission(0x3C);	// Start + slave address
	write(0x40);				// Register adress
	write(data);				// Byte
	endTransmission1();			// Stop command

}

// Sets cursor to start point 
void setCursorXY(uint8_t X, uint8_t Y){
	// Y - 1 unit = 1 page (8 pixel rows)
	// X - 1 unit = 8 pixel columns
	sendCommand(0x00 + (8*X & 0x0F)); 		//set column lower address
	sendCommand(0x10 + ((8*X>>4)&0x0F)); 	//set column higher address
	sendCommand(0xB0 + Y); 					//set page address
	
}

// Clear Display on screen
void clearDisplay()	{
	for(uint8_t page = 0; page < 4; page++) {
		setCursorXY(0, page);
		for(uint8_t column = 0; column < 128; column++){  //clear all columns
			sendData(0);
		}
	}
	setCursorXY(0,0);
}

void init(){
	begin();						// initialize I2C 
	
	sendCommand(0xA8);				// Set multiplexer
	sendCommand(0x1F);				// 0 - pixel height -1 => 32 -1 = 31 => 0x1F
	
	setCursorXY(0,0);
	
	sendCommand(0xDA);				// COM pins
	sendCommand(0x02);
	
	sendCommand(0xA6);				// Set normal display
	
	sendCommand(0x20); 				//set addressing mode
	sendCommand(0x00); 				//set page addressing mode 10h, horizontal addressing mode 01h, vertical addressing mode 00h
	
	sendCommand(0x8d);				//Charge Pump
	sendCommand(0x14);
	
	sendCommand(0xAF);				// Turn display ON
	_delay_ms(10);
	
	clearDisplay();
}

// Print character
void printChar(char C, uint8_t X, uint8_t Y){

	if ( X < 128 )
	setCursorXY(X, Y);

	//Ignore unused ASCII characters. Modified the range to support multilingual characters.
	if(C < 32 || C > 127)
	C='*'; //star - indicate characters that can't be displayed

	for(uint8_t i=0; i<8; i++) {
		//read bytes from code memory
		sendData(pgm_read_byte(&BasicFont[C-32][i])); //font array starts at 0, ASCII starts at 32. Hence the translation
	}
}


// Print string at starting position X,Y
void printString(const char *String, uint8_t X, uint8_t Y, uint8_t numChar){

	if ( X < 128 )
	setCursorXY(X, Y);

	uint8_t count = 0;
	uint8_t count1 = 0;
	
	while(String[count] && count<numChar){
		printChar(String[count++],X++,Y);
		if (count == 16)
		{
			Y++;
		} 
		else if (count == 31)
		{
			Y++;
		}
		else if (count == 46)
		{
			Y++;
		}
	}
}

